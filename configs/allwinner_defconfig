## configs/allwinner_defconfig
```kconfig
BR2_arm=y
BR2_cortex_a8=y
BR2_JLEVEL=9
BR2_OPTIMIZE_3=y
BR2_TOOLCHAIN_EXTERNAL=y
BR2_PACKAGE_GDB=y
BR2_TOOLCHAIN_EXTERNAL_GDB_SERVER_COPY=y
BR2_TARGET_OPTIMIZATION="-O3 -pipe -march=armv7-a -mtune=cortex-a8 -mfpu=vfpv3-d16"
BR2_TARGET_GENERIC_HOSTNAME="allwinner-xbmc"
BR2_TARGET_GENERIC_ISSUE="Welcome to Allwinner"
BR2_ROOTFS_DEVICE_CREATION_DYNAMIC_UDEV=y
BR2_ROOTFS_SKELETON_CUSTOM=y
BR2_ROOTFS_SKELETON_CUSTOM_PATH="board/allwinner/ax/skeleton"
BR2_ROOTFS_POST_BUILD_SCRIPT="board/allwinner/ax/postbuild.sh"
BR2_PACKAGE_BUSYBOX_CONFIG="board/allwinner/ax/busybox.config"
BR2_PACKAGE_ALSA_UTILS=y
BR2_PACKAGE_ALSA_UTILS_APLAY=y
BR2_PACKAGE_FLAC=y
BR2_PACKAGE_WAVPACK=y
BR2_PACKAGE_OPROFILE=y
BR2_PACKAGE_BINUTILS_TARGET=y
BR2_DBUS_LIBXML2=y
BR2_PACKAGE_DBUS_PYTHON=y
BR2_PACKAGE_UDEV_RULES_GEN=y
BR2_PACKAGE_UDEV_ALL_EXTRAS=y
BR2_PACKAGE_USBMOUNT=y
BR2_PACKAGE_USBUTILS=y
BR2_PACKAGE_USBUTILS_ZLIB=y
BR2_PACKAGE_PYTHON=y
BR2_PACKAGE_PYTHON_BZIP2=y
BR2_PACKAGE_PYTHON_BSDDB=y
BR2_PACKAGE_PYTHON_CODECSCJK=y
BR2_PACKAGE_PYTHON_CURSES=y
BR2_PACKAGE_PYTHON_PYEXPAT=y
BR2_PACKAGE_PYTHON_READLINE=y
BR2_PACKAGE_PYTHON_SSL=y
BR2_PACKAGE_PYTHON_SQLITE=y
BR2_PACKAGE_PYTHON_ZLIB=y
BR2_PACKAGE_LIBMAD=y
BR2_PACKAGE_LIBSAMPLERATE=y
BR2_PACKAGE_LZO=y
BR2_PACKAGE_LIBGCRYPT=y
BR2_PACKAGE_MYSQL_CLIENT=y
BR2_PACKAGE_FONTCONFIG=y
BR2_PACKAGE_LIBPNG=y
BR2_PACKAGE_LIBUNGIF=y
BR2_PACKAGE_TIFF=y
BR2_PACKAGE_LIBUSB_COMPAT=y
BR2_PACKAGE_LIBMPEG2=y
BR2_PACKAGE_LIBTHEORA=y
BR2_PACKAGE_LIBCURL=y
BR2_PACKAGE_LIBMICROHTTPD=y
BR2_PACKAGE_BOOST=y
BR2_PACKAGE_BOOST_MULTITHREADED=y
BR2_PACKAGE_BOOST_THREAD=y
BR2_PACKAGE_PCRE=y
BR2_PACKAGE_YAJL=y
BR2_PACKAGE_AVAHI=y
BR2_PACKAGE_AVAHI_DAEMON=y
BR2_PACKAGE_DROPBEAR=y
BR2_PACKAGE_DROPBEAR_DISABLE_REVERSEDNS=y
BR2_PACKAGE_IPERF=y
BR2_PACKAGE_NFS_UTILS=y
BR2_PACKAGE_NFS_UTILS_RPCDEBUG=y
BR2_PACKAGE_NFS_UTILS_RPC_LOCKD=y
BR2_PACKAGE_NFS_UTILS_RPC_RQUOTAD=y
BR2_PACKAGE_NTP=y
# BR2_PACKAGE_NTP_NTPD is not set
BR2_PACKAGE_NTP_NTPDATE=y
BR2_PACKAGE_PORTMAP=y
BR2_PACKAGE_SAMBA=y
# BR2_PACKAGE_SAMBA_SWAT is not set
BR2_PACKAGE_SAMBA_LIBSMBCLIENT=y
BR2_PACKAGE_WIRELESS_TOOLS=y
BR2_PACKAGE_WIRELESS_TOOLS_LIB=y
BR2_PACKAGE_WPA_SUPPLICANT=y
BR2_PACKAGE_WPA_SUPPLICANT_EAP=y
BR2_PACKAGE_WPA_SUPPLICANT_CLI=y
BR2_PACKAGE_WPA_SUPPLICANT_PASSPHRASE=y
BR2_PACKAGE_WPA_SUPPLICANT_AP_SUPPORT=y
BR2_PACKAGE_HTOP=y
BR2_PACKAGE_UTIL_LINUX_AGETTY=y
BR2_PACKAGE_NANO=y
BR2_PACKAGE_AFPFS_NG=y
BR2_PACKAGE_FRIBIDI=y
BR2_PACKAGE_JASPER=y
BR2_PACKAGE_LIBASS=y
BR2_PACKAGE_LIBBLURAY=y
BR2_PACKAGE_LIBCDIO=y
BR2_PACKAGE_LIBMODPLUG=y
BR2_PACKAGE_LIBNFS=y
BR2_PACKAGE_LIBCEC=y
# BR2_PACKAGE_LIBCEC_RBP is not set
BR2_PACKAGE_LIBPLIST=y
BR2_PACKAGE_LIBRTMP=y
BR2_PACKAGE_LIBSHAIRPORT=y
BR2_PACKAGE_LIBSSH2=y
BR2_PACKAGE_TINYXML=y
BR2_PACKAGE_TAGLIB18=y
BR2_PACKAGE_LIBSSH=y
BR2_PACKAGE_LIBCEDAR=y
BR2_PACKAGE_ALLWINNER_MALI=y
BR2_PACKAGE_ALLWINNER_CEDAR=y
BR2_LINUX_KERNEL=y
BR2_LINUX_KERNEL_CUSTOM_GIT=y
BR2_LINUX_KERNEL_CUSTOM_GIT_REPO_URL="git://github.com/linux-sunxi/linux-sunxi.git"
BR2_LINUX_KERNEL_CUSTOM_GIT_VERSION="09946bae6c414e62c066c57169100c62cd303500"
BR2_LINUX_KERNEL_USE_CUSTOM_CONFIG=y
BR2_LINUX_KERNEL_CUSTOM_CONFIG_FILE="board/allwinner/ax/kernel.config"
BR2_LINUX_KERNEL_UIMAGE=y
```

## configs/carrierone_defconfig
```kconfig
BR2_arm=y
BR2_cortex_a9=y
BR2_JLEVEL=9
BR2_OPTIMIZE_3=y
BR2_TOOLCHAIN_EXTERNAL=y
BR2_PACKAGE_GDB=y
BR2_TOOLCHAIN_EXTERNAL_GDB_SERVER_COPY=y
BR2_TARGET_OPTIMIZATION="-O3 -pipe -march=armv7-a -mtune=cortex-a9 -mfpu=vfpv3-d16"
BR2_TARGET_GENERIC_HOSTNAME="carrierone-xbmc"
BR2_TARGET_GENERIC_ISSUE="Welcome to CarrierOne"
BR2_ROOTFS_DEVICE_CREATION_DYNAMIC_UDEV=y
BR2_ROOTFS_SKELETON_CUSTOM=y
BR2_ROOTFS_SKELETON_CUSTOM_PATH="board/freescale/carrierone/skeleton"
BR2_ROOTFS_POST_BUILD_SCRIPT="board/freescale/carrierone/postbuild.sh"
BR2_PACKAGE_BUSYBOX_CONFIG="board/freescale/carrierone/busybox.config"
BR2_PACKAGE_BUSYBOX_SHOW_OTHERS=y
BR2_PACKAGE_ALSA_UTILS=y
BR2_PACKAGE_ALSA_UTILS_ALSACONF=y
BR2_PACKAGE_ALSA_UTILS_AMIDI=y
BR2_PACKAGE_ALSA_UTILS_AMIXER=y
BR2_PACKAGE_ALSA_UTILS_APLAY=y
BR2_PACKAGE_ALSA_UTILS_IECSET=y
BR2_PACKAGE_ALSA_UTILS_ACONNECT=y
BR2_PACKAGE_ALSA_UTILS_APLAYMIDI=y
BR2_PACKAGE_ALSA_UTILS_ARECORDMIDI=y
BR2_PACKAGE_ALSA_UTILS_ASEQDUMP=y
BR2_PACKAGE_ALSA_UTILS_ASEQNET=y
BR2_PACKAGE_ALSA_UTILS_SPEAKER_TEST=y
BR2_PACKAGE_FLAC=y
BR2_PACKAGE_MPG123=y
BR2_PACKAGE_WAVPACK=y
BR2_PACKAGE_DHRYSTONE=y
BR2_PACKAGE_LATENCYTOP=y
BR2_PACKAGE_LMBENCH=y
BR2_PACKAGE_NETPERF=y
BR2_PACKAGE_WHETSTONE=y
BR2_PACKAGE_E2FSPROGS=y
BR2_PACKAGE_IMX_VPU_PLATFORM_IMX6Q=y
BR2_PACKAGE_FIRMWARE_IMX=y
BR2_PACKAGE_GPU_VIV_BIN_MX6Q=y
BR2_PACKAGE_I2C_TOOLS=y
BR2_PACKAGE_LM_SENSORS=y
BR2_PACKAGE_LM_SENSORS_FANCONTROL=y
BR2_PACKAGE_LM_SENSORS_PWMCONFIG=y
BR2_PACKAGE_LM_SENSORS_SENSORS_DETECT=y
BR2_PACKAGE_MEMTESTER=y
BR2_PACKAGE_PARTED=y
BR2_PACKAGE_SMARTMONTOOLS=y
BR2_PACKAGE_PYTHON=y
BR2_PACKAGE_PYTHON_BZIP2=y
BR2_PACKAGE_PYTHON_BSDDB=y
BR2_PACKAGE_PYTHON_CURSES=y
BR2_PACKAGE_PYTHON_PYEXPAT=y
BR2_PACKAGE_PYTHON_READLINE=y
BR2_PACKAGE_PYTHON_SSL=y
BR2_PACKAGE_PYTHON_SQLITE=y
BR2_PACKAGE_PYTHON_ZLIB=y
BR2_PACKAGE_LIBMAD=y
BR2_PACKAGE_LIBSAMPLERATE=y
BR2_PACKAGE_LZO=y
BR2_PACKAGE_LIBGCRYPT=y
BR2_PACKAGE_MYSQL_CLIENT=y
BR2_PACKAGE_FONTCONFIG=y
BR2_PACKAGE_LIBPNG=y
BR2_PACKAGE_LIBUNGIF=y
BR2_PACKAGE_TIFF=y
BR2_PACKAGE_LIBUSB_COMPAT=y
BR2_PACKAGE_LIBMPEG2=y
BR2_PACKAGE_LIBTHEORA=y
BR2_PACKAGE_LIBFSLVPUWRAP=y
BR2_PACKAGE_LIBCURL=y
BR2_PACKAGE_LIBMICROHTTPD=y
BR2_PACKAGE_BOOST=y
BR2_PACKAGE_BOOST_THREAD=y
BR2_PACKAGE_PCRE=y
BR2_PACKAGE_LIBXSLT=y
BR2_PACKAGE_YAJL=y
BR2_PACKAGE_AVAHI=y
BR2_PACKAGE_AVAHI_DAEMON=y
BR2_PACKAGE_BLUEZ_UTILS=y
BR2_PACKAGE_BLUEZ_UTILS_COMPAT=y
BR2_PACKAGE_BLUEZ_UTILS_AUDIO=y
BR2_PACKAGE_BLUEZ_UTILS_USB=y
BR2_PACKAGE_DROPBEAR=y
BR2_PACKAGE_DROPBEAR_DISABLE_REVERSEDNS=y
BR2_PACKAGE_ETHTOOL=y
BR2_PACKAGE_IPERF=y
BR2_PACKAGE_LRZSZ=y
BR2_PACKAGE_MII_DIAG=y
BR2_PACKAGE_NFS_UTILS=y
BR2_PACKAGE_NFS_UTILS_RPCDEBUG=y
BR2_PACKAGE_NFS_UTILS_RPC_LOCKD=y
BR2_PACKAGE_NFS_UTILS_RPC_RQUOTAD=y
BR2_PACKAGE_NTP=y
# BR2_PACKAGE_NTP_NTPD is not set
BR2_PACKAGE_NTP_NTPDATE=y
BR2_PACKAGE_SAMBA=y
BR2_PACKAGE_TCPDUMP=y
BR2_PACKAGE_TCPDUMP_SMB=y
BR2_PACKAGE_WIRELESS_TOOLS=y
BR2_PACKAGE_WIRELESS_TOOLS_LIB=y
BR2_PACKAGE_KMOD_TOOLS=y
BR2_PACKAGE_MODULE_INIT_TOOLS=y
BR2_PACKAGE_AFPFS_NG=y
BR2_PACKAGE_FRIBIDI=y
BR2_PACKAGE_JASPER=y
BR2_PACKAGE_LIBASS=y
BR2_PACKAGE_LIBBLURAY=y
BR2_PACKAGE_LIBCDIO=y
BR2_PACKAGE_LIBMODPLUG=y
BR2_PACKAGE_LIBNFS=y
BR2_PACKAGE_LIBCEC=y
# BR2_PACKAGE_LIBCEC_RBP is not set
BR2_PACKAGE_LIBPLIST=y
BR2_PACKAGE_LIBRTMP=y
BR2_PACKAGE_LIBSHAIRPORT=y
BR2_PACKAGE_LIBSSH2=y
BR2_PACKAGE_SG3_UTILS=y
BR2_PACKAGE_TINYXML=y
BR2_PACKAGE_TAGLIB18=y
BR2_PACKAGE_LIBSSH=y
BR2_TARGET_UBOOT=y
BR2_TARGET_UBOOT_BOARDNAME="mx6_cubox-i"
BR2_TARGET_UBOOT_CUSTOM_GIT=y
BR2_TARGET_UBOOT_CUSTOM_PATCH_DIR="board/freescale/carrierone/uboot-imx"
BR2_TARGET_UBOOT_CUSTOM_GIT_REPO_URL="https://github.com/SolidRun/u-boot-imx6.git"
BR2_TARGET_UBOOT_CUSTOM_GIT_VERSION="ed888a1e885eda9e8d8313e6bd09c521f193f29d"
BR2_TARGET_UBOOT_FORMAT_IMG=y
BR2_TARGET_UBOOT_SPL=y
BR2_TARGET_UBOOT_SPL_NAME="SPL"
BR2_LINUX_KERNEL=y
BR2_LINUX_KERNEL_CUSTOM_GIT=y
BR2_LINUX_KERNEL_CUSTOM_GIT_REPO_URL="https://github.com/SolidRun/linux-linaro-stable-mx6"
BR2_LINUX_KERNEL_CUSTOM_GIT_VERSION="592b2d941dc3ecb6335d6820757340ffb5a192c8"
BR2_LINUX_KERNEL_PATCH="board/freescale/carrierone/hummingboard.patch"
BR2_LINUX_KERNEL_DEFCONFIG="imx_v7_cubox-i_hummingboard"
BR2_LINUX_KERNEL_CARRIERONE=y
BR2_LINUX_KERNEL_INSTALL_TARGET=y
```

## configs/rbp_defconfig
```kconfig
BR2_arm=y
BR2_arm1176jzf_bcm=y
BR2_JLEVEL=4
BR2_OPTIMIZE_3=y
BR2_TOOLCHAIN_CTNG=y
BR2_TOOLCHAIN_CTNG_glibc=y
BR2_TOOLCHAIN_CTNG_experimental=y
BR2_TOOLCHAIN_CTNG_CONFIG="board/bcm/rbp/crosstool-ng.config-glibc"
BR2_TOOLCHAIN_CTNG_CXX=y
BR2_PACKAGE_GDB=y
BR2_PACKAGE_GDB_SERVER=y
BR2_PACKAGE_GDB_HOST=y
# BR2_SOFT_FLOAT is not set
BR2_TARGET_OPTIMIZATION="-O3 -mfpu=vfp -mfloat-abi=hard -pipe"
BR2_TARGET_GENERIC_HOSTNAME="rbp-xbmc"
BR2_TARGET_GENERIC_ISSUE="Welcome to Raspberry PI"
BR2_ROOTFS_DEVICE_CREATION_DYNAMIC_UDEV=y
BR2_ROOTFS_SKELETON_CUSTOM=y
BR2_ROOTFS_SKELETON_CUSTOM_PATH="board/bcm/rbp/skeleton"
BR2_ROOTFS_POST_BUILD_SCRIPT="board/bcm/rbp/postbuild.sh"
BR2_PACKAGE_BUSYBOX_CONFIG="board/bcm/rbp/busybox.config"
BR2_PACKAGE_BUSYBOX_SHOW_OTHERS=y
BR2_PACKAGE_ALSA_UTILS=y
BR2_PACKAGE_ALSA_UTILS_APLAY=y
BR2_PACKAGE_FLAC=y
BR2_PACKAGE_WAVPACK=y
BR2_PACKAGE_OPROFILE=y
BR2_PACKAGE_BINUTILS_TARGET=y
BR2_DBUS_LIBXML2=y
BR2_PACKAGE_UDEV_RULES_GEN=y
BR2_PACKAGE_UDEV_ALL_EXTRAS=y
BR2_PACKAGE_USBMOUNT=y
BR2_PACKAGE_USBUTILS=y
BR2_PACKAGE_USBUTILS_ZLIB=y
BR2_PACKAGE_PYTHON=y
BR2_PACKAGE_PYTHON_BZIP2=y
BR2_PACKAGE_PYTHON_BSDDB=y
BR2_PACKAGE_PYTHON_CODECSCJK=y
BR2_PACKAGE_PYTHON_CURSES=y
BR2_PACKAGE_PYTHON_PYEXPAT=y
BR2_PACKAGE_PYTHON_READLINE=y
BR2_PACKAGE_PYTHON_SSL=y
BR2_PACKAGE_PYTHON_SQLITE=y
BR2_PACKAGE_PYTHON_ZLIB=y
BR2_PACKAGE_LIBMAD=y
BR2_PACKAGE_LIBSAMPLERATE=y
BR2_PACKAGE_LZO=y
BR2_PACKAGE_LIBGCRYPT=y
BR2_PACKAGE_MYSQL_CLIENT=y
BR2_PACKAGE_FONTCONFIG=y
BR2_PACKAGE_LIBPNG=y
BR2_PACKAGE_LIBUNGIF=y
BR2_PACKAGE_TIFF=y
BR2_PACKAGE_LIBUSB_COMPAT=y
BR2_PACKAGE_LIBMPEG2=y
BR2_PACKAGE_LIBTHEORA=y
BR2_PACKAGE_LIBCURL=y
BR2_PACKAGE_LIBMICROHTTPD=y
BR2_PACKAGE_BOOST=y
BR2_PACKAGE_BOOST_MULTITHREADED=y
BR2_PACKAGE_BOOST_THREAD=y
BR2_PACKAGE_PCRE=y
BR2_PACKAGE_YAJL=y
BR2_PACKAGE_VC=y
BR2_PACKAGE_AVAHI=y
BR2_PACKAGE_AVAHI_DAEMON=y
BR2_PACKAGE_DROPBEAR=y
BR2_PACKAGE_DROPBEAR_DISABLE_REVERSEDNS=y
BR2_PACKAGE_IPERF=y
BR2_PACKAGE_NFS_UTILS=y
BR2_PACKAGE_NFS_UTILS_RPCDEBUG=y
BR2_PACKAGE_NFS_UTILS_RPC_LOCKD=y
BR2_PACKAGE_NFS_UTILS_RPC_RQUOTAD=y
BR2_PACKAGE_NTP=y
# BR2_PACKAGE_NTP_NTPD is not set
BR2_PACKAGE_NTP_NTPDATE=y
BR2_PACKAGE_PORTMAP=y
BR2_PACKAGE_SAMBA=y
# BR2_PACKAGE_SAMBA_SWAT is not set
BR2_PACKAGE_SAMBA_LIBSMBCLIENT=y
BR2_PACKAGE_WIRELESS_TOOLS=y
BR2_PACKAGE_WIRELESS_TOOLS_LIB=y
BR2_PACKAGE_WPA_SUPPLICANT=y
BR2_PACKAGE_WPA_SUPPLICANT_EAP=y
BR2_PACKAGE_WPA_SUPPLICANT_CLI=y
BR2_PACKAGE_WPA_SUPPLICANT_PASSPHRASE=y
BR2_PACKAGE_WPA_SUPPLICANT_AP_SUPPORT=y
BR2_PACKAGE_WPA_SUPPLICANT_WPS=y
BR2_PACKAGE_SCREEN=y
BR2_PACKAGE_HTOP=y
BR2_PACKAGE_KMOD_TOOLS=y
BR2_PACKAGE_MODULE_INIT_TOOLS=y
BR2_PACKAGE_UTIL_LINUX_AGETTY=y
BR2_PACKAGE_NANO=y
BR2_PACKAGE_AFPFS_NG=y
BR2_PACKAGE_FRIBIDI=y
BR2_PACKAGE_JASPER=y
BR2_PACKAGE_LIBASS=y
BR2_PACKAGE_LIBBLURAY=y
BR2_PACKAGE_LIBCDIO=y
BR2_PACKAGE_LIBMODPLUG=y
BR2_PACKAGE_LIBNFS=y
BR2_PACKAGE_LIBCEC=y
BR2_PACKAGE_LIBPLIST=y
BR2_PACKAGE_LIBRTMP=y
BR2_PACKAGE_LIBSHAIRPORT=y
BR2_PACKAGE_LIBSSH2=y
BR2_PACKAGE_TINYXML=y
BR2_PACKAGE_TAGLIB18=y
BR2_PACKAGE_LIBSSH=y
BR2_LINUX_KERNEL=y
BR2_LINUX_KERNEL_CUSTOM_GIT=y
BR2_LINUX_KERNEL_CUSTOM_GIT_REPO_URL="https://github.com/raspberrypi/linux.git"
BR2_LINUX_KERNEL_CUSTOM_GIT_VERSION="5d5301e5983cb5d4066e1dcd1d5f9934c18e428c"
BR2_LINUX_KERNEL_USE_CUSTOM_CONFIG=y
BR2_LINUX_KERNEL_CUSTOM_CONFIG_FILE="board/bcm/rbp/kernel.config-3.6"
```

## configs/rbp_xbmc_defconfig
```kconfig
BR2_arm=y
BR2_arm1176jzf_bcm=y
BR2_JLEVEL=9
BR2_OPTIMIZE_3=y
BR2_TOOLCHAIN_CTNG=y
BR2_TOOLCHAIN_CTNG_glibc=y
BR2_TOOLCHAIN_CTNG_experimental=y
BR2_TOOLCHAIN_CTNG_CONFIG="board/bcm/rbp/crosstool-ng.config-glibc"
BR2_TOOLCHAIN_CTNG_CXX=y
BR2_PACKAGE_GDB=y
BR2_PACKAGE_GDB_SERVER=y
BR2_PACKAGE_GDB_HOST=y
# BR2_SOFT_FLOAT is not set
BR2_TARGET_OPTIMIZATION="-O3 -mfpu=vfp -mfloat-abi=hard -pipe"
BR2_TARGET_GENERIC_HOSTNAME="rbp-xbmc"
BR2_TARGET_GENERIC_ISSUE="Welcome to Raspberry PI"
BR2_ROOTFS_DEVICE_CREATION_DYNAMIC_UDEV=y
BR2_ROOTFS_SKELETON_CUSTOM=y
BR2_ROOTFS_SKELETON_CUSTOM_PATH="board/bcm/rbp/skeleton"
BR2_ROOTFS_POST_BUILD_SCRIPT="board/bcm/rbp/postbuild.sh"
BR2_PACKAGE_BUSYBOX_CONFIG="board/bcm/rbp/busybox.config"
BR2_PACKAGE_ALSA_UTILS_APLAY=y
BR2_PACKAGE_OPROFILE=y
BR2_PACKAGE_BINUTILS_TARGET=y
BR2_DBUS_LIBXML2=y
BR2_PACKAGE_DBUS_PYTHON=y
BR2_PACKAGE_UDEV_RULES_GEN=y
BR2_PACKAGE_UDEV_ALL_EXTRAS=y
BR2_PACKAGE_USBMOUNT=y
BR2_PACKAGE_USBUTILS=y
BR2_PACKAGE_USBUTILS_ZLIB=y
BR2_PACKAGE_PYTHON_CODECSCJK=y
BR2_PACKAGE_BOOST_MULTITHREADED=y
BR2_PACKAGE_DROPBEAR=y
BR2_PACKAGE_DROPBEAR_DISABLE_REVERSEDNS=y
BR2_PACKAGE_IPERF=y
BR2_PACKAGE_NFS_UTILS=y
BR2_PACKAGE_NFS_UTILS_RPCDEBUG=y
BR2_PACKAGE_NFS_UTILS_RPC_LOCKD=y
BR2_PACKAGE_NFS_UTILS_RPC_RQUOTAD=y
BR2_PACKAGE_NTP=y
# BR2_PACKAGE_NTP_NTPD is not set
BR2_PACKAGE_NTP_NTPDATE=y
BR2_PACKAGE_PORTMAP=y
# BR2_PACKAGE_SAMBA_SWAT is not set
BR2_PACKAGE_SAMBA_LIBSMBCLIENT=y
BR2_PACKAGE_WIRELESS_TOOLS=y
BR2_PACKAGE_WIRELESS_TOOLS_LIB=y
BR2_PACKAGE_WPA_SUPPLICANT=y
BR2_PACKAGE_WPA_SUPPLICANT_EAP=y
BR2_PACKAGE_WPA_SUPPLICANT_CLI=y
BR2_PACKAGE_WPA_SUPPLICANT_PASSPHRASE=y
BR2_PACKAGE_WPA_SUPPLICANT_AP_SUPPORT=y
BR2_PACKAGE_HTOP=y
BR2_PACKAGE_UTIL_LINUX_AGETTY=y
BR2_PACKAGE_NANO=y
BR2_PACKAGE_LIBCEC=y
BR2_PACKAGE_LIBCEC_RBP=y
BR2_PACKAGE_LIBPLIST=y
BR2_PACKAGE_TINYXML=y
BR2_PACKAGE_TAGLIB18=y
BR2_PACKAGE_XBMC=y
BR2_LINUX_KERNEL=y
BR2_LINUX_KERNEL_CUSTOM_GIT=y
BR2_LINUX_KERNEL_CUSTOM_GIT_REPO_URL="https://github.com/raspberrypi/linux.git"
BR2_LINUX_KERNEL_CUSTOM_GIT_VERSION="9cecb89ac95ffe8f9963250334e3df848fb3732b"
BR2_LINUX_KERNEL_USE_CUSTOM_CONFIG=y
BR2_LINUX_KERNEL_CUSTOM_CONFIG_FILE="board/bcm/rbp/kernel.config-3.10"
```

## package/allwinner-cedar/Config.in
```kconfig
config BR2_PACKAGE_ALLWINNER_CEDAR
	bool "allwinnercedar"
	help
	  Allwinner cedar decoder lib

	  https://github.com/linux-sunxi/cedarx-libs
```

## package/allwinner-mali/Config.in
```kconfig
config BR2_PACKAGE_ALLWINNER_MALI
	bool "allwinnermali"
	help
	  Allwinner mali userspace

	  https://github.com/linux-sunxi/mali-libs/
```

## package/xbmc/Config.in
```kconfig
menu "XBMC addons"
source "package/xbmc/afpfs-ng/Config.in"
source "package/xbmc/fribidi/Config.in"
source "package/xbmc/jasper/Config.in"
source "package/xbmc/libass/Config.in"
source "package/xbmc/libbluray/Config.in"
source "package/xbmc/libcdio/Config.in"
source "package/xbmc/libenca/Config.in"
source "package/xbmc/libmodplug/Config.in"
source "package/xbmc/libnfs/Config.in"
source "package/xbmc/lockdev/Config.in"
source "package/xbmc/libcec/Config.in"
source "package/xbmc/libplist/Config.in"
source "package/xbmc/librtmp/Config.in"
source "package/xbmc/libshairport/Config.in"
source "package/xbmc/libshairplay/Config.in"
source "package/xbmc/libssh2/Config.in"
source "package/xbmc/sg3_utils/Config.in"
source "package/xbmc/tinyxml/Config.in"
source "package/xbmc/udisks/Config.in"
source "package/xbmc/taglib18/Config.in"
source "package/xbmc/libssh/Config.in"
source "package/xbmc/xbmc/Config.in"
source "package/xbmc/tvheadend/Config.in"
source "package/xbmc/v4lutils/Config.in"
source "package/xbmc/libcedar/Config.in"
endmenu
```

## package/xbmc/libbluray/Config.in
```kconfig
config BR2_PACKAGE_LIBBLURAY
	bool "libbluray"
	help
	  library for acces bluray discs

	  http://github.com/sahlberg/libnfs
```

## package/xbmc/libcec/Config.in
```kconfig
config BR2_PACKAGE_LIBCEC
	select BR2_PACKAGE_LOCKDEV
	bool "libcec"
	help
	  hdmi cec library.

	  https://github.com/Pulse-Eight/libcec

config BR2_PACKAGE_LIBCEC_RBP
	bool "libcec_rbp"
	default y
```

## package/xbmc/libcedar/Config.in
```kconfig
config BR2_PACKAGE_LIBCEDAR
	bool "libcedar"
	help
	  Decoder library for Allwinners libvecore

	  https://github.com/huceke/libcedar
```

## package/xbmc/libnfs/Config.in
```kconfig
config BR2_PACKAGE_LIBNFS
	bool "libnfs"
	help
	  nfs userspace implementation.

	  http://github.com/sahlberg/libnfs
```

## package/xbmc/libshairplay/Config.in
```kconfig
config BR2_PACKAGE_LIBSHAIRPLAY
        bool "libshairplay"
        help
          LIBSHAIRPLAY is a client library that emulates an airplay server
```

## package/xbmc/lockdev/Config.in
```kconfig
config BR2_PACKAGE_LOCKDEV
	bool "lockdev"
	help
	  library for locking devices

	  http://packages.debian.org/source/sid/lockdev
```

## package/xbmc/sg3_utils/Config.in
```kconfig
config BR2_PACKAGE_SG3_UTILS
	bool "sg3_utils"
	help
	  sg3_utils: a package of utilities for accessing devices that use SCSI command sets.

	  http://freshmeat.net/projects/sg3_utils/
```
